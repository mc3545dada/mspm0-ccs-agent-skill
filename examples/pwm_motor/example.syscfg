/**
 * Example SysConfig file for an MSPM0G3507 PWM motor reference.
 * Adapt device, package, SDK product, timer, pins, and names to the real project.
 *
 * @cliArgs --device "MSPM0G350X" --part "Default" --package "LQFP-64(PM)" --product "mspm0_sdk@2.05.01.01"
 * @versions {"tool":"1.24.0+4110"}
 */

const GPIO = scripting.addModule("/ti/driverlib/GPIO", {}, false);
const GPIO1 = GPIO.addInstance();
const GPIO2 = GPIO.addInstance();
const PWM = scripting.addModule("/ti/driverlib/PWM", {}, false);
const PWM1 = PWM.addInstance();
const SYSCTL = scripting.addModule("/ti/driverlib/SYSCTL");
const Board = scripting.addModule("/ti/driverlib/Board", {}, false);

GPIO1.$name                         = "m1o1";
GPIO1.port                          = "PORTA";
GPIO1.associatedPins[0].$name       = "PIN_8";
GPIO1.associatedPins[0].assignedPin = "8";
GPIO1.associatedPins[0].direction   = "OUTPUT";

GPIO2.$name                         = "m1o2";
GPIO2.port                          = "PORTA";
GPIO2.associatedPins[0].$name       = "PIN_9";
GPIO2.associatedPins[0].assignedPin = "9";
GPIO2.associatedPins[0].direction   = "OUTPUT";

PWM1.$name                              = "motor1";
PWM1.timerStartTimer                    = true;
PWM1.pwmMode                            = "EDGE_ALIGN_UP";
PWM1.clockDivider                       = 2;
PWM1.peripheral.$assign                 = "TIMA0";
PWM1.peripheral.ccp0Pin.$assign         = "PA0";
PWM1.PWM_CHANNEL_0.$name                = "ti_driverlib_pwm_PWMTimerCC0";
PWM1.ccp0PinConfig.direction            = scripting.forceWrite("OUTPUT");
PWM1.ccp0PinConfig.hideOutputInversion  = scripting.forceWrite(false);
PWM1.ccp0PinConfig.onlyInternalResistor = scripting.forceWrite(false);
PWM1.ccp0PinConfig.passedPeripheralType = scripting.forceWrite("Digital");
PWM1.ccp0PinConfig.$name                = "ti_driverlib_gpio_GPIOPinGeneric0";

SYSCTL.forceDefaultClkConfig = true;
SYSCTL.clockTreeEn           = true;

Board.peripheral.$suggestSolution            = "DEBUGSS";
Board.peripheral.swclkPin.$suggestSolution   = "PA20";
Board.peripheral.swdioPin.$suggestSolution   = "PA19";
GPIO1.associatedPins[0].pin.$suggestSolution = "PA8";
GPIO2.associatedPins[0].pin.$suggestSolution = "PA9";
